## config/boards/shields/preonic_rak/Kconfig.deconfig
```kconfig
if SHIELD_PREONIC_RAK

config ZMK_KEYBOARD_NAME
    default "preonic_rak"

config SPI
    default y

endif
```

## config/boards/shields/preonic_rak/Kconfig.shield
```kconfig
config SHIELD_PREONIC_RAK
    def_bool $(shields_list_contains,preonic_rak)
    select SPI
```
